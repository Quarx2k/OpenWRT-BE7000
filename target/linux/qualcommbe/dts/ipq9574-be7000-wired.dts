// SPDX-License-Identifier: (GPL-2.0+ OR BSD-3-Clause)
/* PPE/QCA8084 Ethernet and modular USB boot; WLAN bring-up is separate. */
/dts-v1/;

#include "ipq9574-be7000.dtsi"
#include "ipq9574-be7000-ethernet.dtsi"
