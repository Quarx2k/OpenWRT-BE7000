// SPDX-License-Identifier: (GPL-2.0+ OR BSD-3-Clause)
/* Native PPE/QCA8084 Ethernet and Qualcomm WLAN with BE7000 USB boot. */
/dts-v1/;

#include "ipq9574-be7000.dtsi"
#include "ipq9574-be7000-wlan.dtsi"
#include "ipq9574-be7000-wcss.dtsi"
#include "ipq9574-be7000-ethernet.dtsi"

&q6v5_wcss {
	status = "okay";
};
